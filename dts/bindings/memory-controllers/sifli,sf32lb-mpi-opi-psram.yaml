## dts/bindings/memory-controllers/sifli,sf32lb-mpi-opi-psram.yaml
```yaml
# Copyright (c) 2025 SiFli Technologies Co., Ltd.
# SPDX-License-Identifier: Apache-2.0

description: |
  SiFli SF32LB Memory Peripheral Interface (MPI) in OPI PSRAM mode.

  This driver supports internal OPI PSRAM on SF32LB52x series chips.
  The PSRAM is connected to MPI1 and operates in Octal-SPI mode.

  Example devicetree configuration for SF32LB525:

    &mpi1 {
      compatible = "sifli,sf32lb-mpi-opi-psram";
      reg = <0x50041000 0x1000>, <0x10000000 DT_SIZE_M(8)>;
      reg-names = "ctrl", "psram";
      clocks = <&rcc_clk SF32LB52X_CLOCK_MPI1>;
      status = "okay";
    };

compatible: "sifli,sf32lb-mpi-opi-psram"

include: [base.yaml, pinctrl-device.yaml]

properties:
  reg:
    required: true
    description: |
      Memory-mapped addresses for MPI controller and PSRAM memory region.
      First entry is the MPI controller registers, second is the PSRAM
      memory-mapped region.

  reg-names:
    required: true
    description: |
      Names for the reg entries. Must be "ctrl" and "psram".

  clocks:
    required: true
    description: |
      Clock source for the MPI controller.

  power-supply:
    type: phandle
    description: |
      Reference to the regulator that supplies power to the PSRAM.
      For SF32LB525/527, this is typically the internal 1.8V LDO (ldo18).
```

## dts/bindings/regulator/sifli,sf32lb-peri-ldo.yaml
```yaml
# Copyright (c) 2025 SiFli Technologies Co., Ltd.
# SPDX-License-Identifier: Apache-2.0

description: |
  SiFli SF32LB52x Peripheral LDO Regulators.

  This node provides access to internal LDOs in the PMUC (Power Management Unit Controller):
  - ldo18: 1.8V LDO for PSRAM (VDDSIP)
  - ldo2-3v3: 3.3V LDO2 for peripherals
  - ldo3-3v3: 3.3V LDO3 for peripherals

  Example:
    peri_ldo: peri-ldo@500ca060 {
      compatible = "sifli,sf32lb-peri-ldo";
      reg = <0x500ca060 0x4>;
      #address-cells = <1>;
      #size-cells = <0>;

      ldo18: ldo18@0 {
        reg = <0>;
        regulator-min-microvolt = <1800000>;
        regulator-max-microvolt = <1800000>;
        regulator-boot-on;
      };
    };

compatible: "sifli,sf32lb-peri-ldo"

include: base.yaml

properties:
  reg:
    required: true
    description: |
      Address of the PERI_LDO register in PMUC.

  "#address-cells":
    const: 1

  "#size-cells":
    const: 0

child-binding:
  include:
    - name: regulator.yaml
      property-allowlist:
        - regulator-name
        - regulator-always-on
        - regulator-boot-on
        - regulator-min-microvolt
        - regulator-max-microvolt

  properties:
    reg:
      type: int
      required: true
      description: |
        LDO index:
        - 0: LDO18 (1.8V for PSRAM)
        - 1: LDO2_3V3 (3.3V)
        - 2: LDO3_3V3 (3.3V)
```

## samples/drivers/memc/sample.yaml
```yaml
sample:
  description: Memory controller sample
  name: memc driver sample
common:
  tags: memc
  harness: console
  harness_config:
    type: one_line
    regex:
      - "Read data matches written data"
tests:
  sample.drivers.memc:
    filter: dt_alias_exists("sram-ext")
    integration_platforms:
      - mimxrt595_evk/mimxrt595s/cm33
  sample.drivers.memc.mspi:
    tags: mspi
    filter: dt_alias_exists("psram0")
    integration_platforms:
      - apollo3p_evb
      - apollo510_evb
  sample.drivers.memc.sf32lb:
    filter: dt_compat_enabled("sifli,sf32lb-mpi-opi-psram")
    integration_platforms:
      - sf32lb52_devkit_lcd
```

## tests/drivers/memc/ram/testcase.yaml
```yaml
tests:
  drivers.memc:
    simulation_exclude:
      - renode
    tags:
      - drivers
      - memc
    depends_on: memc
    integration_platforms:
      - sam4s_xplained
      - sf32lb52_devkit_lcd
    extra_args:
      - platform:da1469x_dk_pro/da14699:EXTRA_DTC_OVERLAY_FILE="da1469x_dk_pro_psram.overlay"
      - platform:da14695_dk_usb/da14695:EXTRA_DTC_OVERLAY_FILE="da14695_dk_usb_psram.overlay"
```
